## sdkconfig.defaults
```kconfig
# ── Target ─────────────────────────────────────────────
CONFIG_IDF_TARGET="esp32p4"

# ── Stack sizes ─────────────────────────────────────────
CONFIG_ESP_MAIN_TASK_STACK_SIZE=8192

# ── lwIP / sockets ──────────────────────────────────────
CONFIG_LWIP_MAX_SOCKETS=16
CONFIG_LWIP_TCP_KEEPALIVE=y
CONFIG_LWIP_SO_REUSE=y

# ── TLS / HTTPS ─────────────────────────────────────────
CONFIG_ESP_TLS_INSECURE=y
CONFIG_ESP_TLS_SKIP_SERVER_CERT_VERIFY=y
CONFIG_MBEDTLS_CERTIFICATE_BUNDLE_DEFAULT_CMN=y

# ── HTTP client ─────────────────────────────────────────
CONFIG_ESP_HTTP_CLIENT_ENABLE_HTTPS=y

# ── Ethernet ─────────────────────────────────────────────
CONFIG_ETH_ENABLED=y
CONFIG_ETH_USE_ESP32_EMAC=y
CONFIG_ETH_PHY_IP101=y
CONFIG_ETH_RMII_CLK_MODE_INPUT_GPIO0=n

# ── Flash / PSRAM ────────────────────────────────────────
CONFIG_ESPTOOLPY_FLASHSIZE_16MB=y
CONFIG_ESPTOOLPY_FLASHSIZE="16m"
CONFIG_ESPTOOLPY_FLASHMODE_QIO=y
CONFIG_SPIRAM_MODE_OCT=y

# ── Log level ────────────────────────────────────────────
CONFIG_LOG_DEFAULT_LEVEL_INFO=y
```
